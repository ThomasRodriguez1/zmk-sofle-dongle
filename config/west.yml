## config/west.yml
```yaml
manifest:
  remotes:
    - name: zmkfirmware
      url-base: https://github.com/zmkfirmware
    - name: tokyo2006
      url-base: https://github.com/tokyo2006
    - name: englmaxi
      url-base: https://github.com/englmaxi
    - name: infely                             # nice_view-battery
      url-base: https://github.com/infely      # nice_view-battery
  projects:
    - name: zmk
      remote: zmkfirmware
      revision: main
      import: app/west.yml
    - name: prospector-zmk-module                 # <--- and these
      remote: tokyo2006                          # <---
      revision: micro_spi2  
    - name: zmk-dongle-display
      remote: englmaxi
      revision: main
    - name: nice-view-battery                  # nice_view-battery
      remote: infely                           # nice_view-battery
      revision: main                           # nice_view-battery
  self:
    path: config
```
